## drivers/display-drivers/Kconfig
```kconfig
# SPDX-License-Identifier: GPL-2.0-only
#
# Display Driver Configuration for MSM/Qualcomm
#
# Copyright (c) 2021, The Linux Foundation. All rights reserved.
# Copyright (c) 2022-2023 Qualcomm Innovation Center, Inc. All rights reserved.

config DRM_MSM
	tristate "MSM DRM"
	depends on DRM
	select DRM_KMS_HELPER
	select SYNC_FILE
	help
	  Qualcomm MSM DRM driver for display subsystem.
	  Supports SDE (Snapdragon Display Engine) and various display interfaces.

config DRM_MSM_SDE
	bool "Snapdragon Display Engine (SDE)"
	depends on DRM_MSM
	default y
	help
	  Enable Snapdragon Display Engine support for advanced display capabilities.

config DRM_MSM_DSI
	bool "DSI (Display Serial Interface) support"
	depends on DRM_MSM
	default y
	help
	  Enable DSI display interface support.

config DSI_PARSER
	bool "DSI Parser"
	depends on DRM_MSM_DSI
	default y
	help
	  Enable DSI panel parser support.

config DRM_MSM_DP
	bool "DisplayPort support"
	depends on DRM_MSM
	default y
	help
	  Enable DisplayPort interface support.

config DRM_MSM_DP_MST
	bool "DisplayPort Multi-Stream Transport (MST)"
	depends on DRM_MSM_DP
	default y
	help
	  Enable DisplayPort MST support for multi-display configurations.

config DRM_MSM_DP_USBPD_LEGACY
	bool "DisplayPort USB PD (Legacy)"
	depends on DRM_MSM_DP
	default n
	help
	  Enable legacy USB PD support for DisplayPort.

config DRM_SDE_WB
	bool "SDE Writeback"
	depends on DRM_MSM_SDE
	default y
	help
	  Enable SDE writeback engine support.

config DRM_SDE_RSC
	bool "SDE Resource State Coordinator (RSC)"
	depends on DRM_MSM_SDE
	default y
	help
	  Enable SDE RSC for power optimization.

config DRM_SDE_VM
	bool "SDE Virtual Machine support"
	depends on DRM_MSM_SDE
	default n
	help
	  Enable SDE virtual machine support.

config DRM_MSM_REGISTER_LOGGING
	bool "MSM DRM Register Logging"
	depends on DRM_MSM
	default n
	help
	  Enable register access logging for debugging.

config QCOM_MDSS_PLL
	bool "QCOM MDSS PLL support"
	depends on DRM_MSM
	default y
	help
	  Enable Qualcomm MDSS PLL support.

config HDCP_QSEECOM
	bool "HDCP via QSEECOM"
	depends on DRM_MSM
	default y
	help
	  Enable HDCP support via QSEECOM.

config MSM_SDE_ROTATOR
	bool "MSM SDE Rotator"
	depends on DRM_MSM_SDE
	default y
	help
	  Enable SDE rotator engine support.

config THERMAL_OF
	bool "Thermal management via Device Tree"
	depends on DRM_MSM
	default y
	help
	  Enable thermal management support via device tree.

config MSM_MMRM
	bool "MSM Multimedia Resource Manager"
	depends on DRM_MSM
	default y
	help
	  Enable MSM Multimedia Resource Manager.

config QTI_HW_FENCE
	bool "QTI Hardware Fence"
	depends on DRM_MSM
	default y
	help
	  Enable QTI hardware fence support.

config QCOM_SPEC_SYNC
	bool "QCOM Spec Sync"
	depends on DRM_MSM
	default y
	help
	  Enable QCOM spec sync support.

config MSM_EXT_DISPLAY
	bool "MSM External Display"
	depends on DRM_MSM
	default y
	help
	  Enable external display support.

config QCOM_WCD939X_I2C
	bool "QCOM WCD939X I2C"
	depends on DRM_MSM
	default n
	help
	  Enable QCOM WCD939X I2C support.

config SECDP
	bool "Samsung SecureDP"
	depends on DRM_MSM_DP
	default n
	help
	  Enable Samsung SecureDP support.

config SECDP_BIGDATA
	bool "Samsung SecureDP Big Data"
	depends on SECDP
	default n
	help
	  Enable Samsung SecureDP big data collection.

config SECDP_LOGGER
	bool "Samsung SecureDP Logger"
	depends on SECDP
	default n
	help
	  Enable Samsung SecureDP logging.

config SECDP_SWITCH
	bool "Samsung SecureDP Switch"
	depends on SECDP
	default n
	help
	  Enable Samsung SecureDP switch support.

config SECDP_DBG
	bool "Samsung SecureDP Debug"
	depends on SECDP
	default n
	help
	  Enable Samsung SecureDP debug features.

config SECDP_FACTORY_DPSWITCH_TEST
	bool "Samsung SecureDP Factory DP Switch Test"
	depends on SECDP
	default n
	help
	  Enable Samsung SecureDP factory DP switch test.

config DISPLAY_SAMSUNG
	bool "Samsung Display Support"
	default n
	help
	  Enable Samsung proprietary display driver support.

config PANEL_E3_S6E3HAE_AMB681AZ01_WQHD
	bool "Samsung E3 S6E3HAE AMB681AZ01 Panel (WQHD)"
	depends on DISPLAY_SAMSUNG
	default n
	help
	  Enable support for Samsung E3 S6E3HAE AMB681AZ01 WQHD panel.

config PANEL_E3_S6E3HAF_AMB679FN01_WQHD
	bool "Samsung E3 S6E3HAF AMB679FN01 Panel (WQHD)"
	depends on DISPLAY_SAMSUNG
	default n
	help
	  Enable support for Samsung E3 S6E3HAF AMB679FN01 WQHD panel.

config SAMSUNG_DEBUG_DISPLAY
	bool "Samsung Display Debug"
	depends on DISPLAY_SAMSUNG
	default n
	help
	  Enable Samsung display debugging features.

config DUAL_PANEL
	bool "Dual Panel Support"
	depends on DISPLAY_SAMSUNG
	default n
	help
	  Enable dual panel operation support.

config PARTIAL_UPDATE
	bool "Partial Update Support"
	depends on DISPLAY_SAMSUNG
	default n
	help
	  Enable partial display update support.

config CABC_FUNCTION
	bool "Content Adaptive Backlight Control (CABC)"
	depends on DISPLAY_SAMSUNG
	default n
	help
	  Enable CABC functionality.

config SUPPORT_POC_FLASH
	bool "POC Flash Support"
	depends on DISPLAY_SAMSUNG
	default n
	help
	  Enable POC (Panel Operation Code) flash support.

config OPCODE_PARSER
	bool "Opcode Parser"
	default n
	help
	  Enable opcode parser support.

config PANEL_KUNIT
	bool "Panel KUnit Tests"
	depends on DISPLAY_SAMSUNG && SEC_KUNIT
	default n
	help
	  Enable KUnit tests for panel drivers.

source "drivers/gpu/drm/msm/Kconfig"
```

## techpack/Kconfig
```kconfig
# SPDX-License-Identifier: GPL-2.0-only
#
# Qualcomm vendor "techpacks" built as part of the main kernel tree.
#
# On GKI 2.0 these drivers live in vendor/qcom/opensource and are built as
# external modules (Bazel DDK / Kbuild M=). Here they are plain kernel
# subdirectories: one `make` builds the kernel, the in-tree modules and every
# techpack module, with a single modpost (no KBUILD_EXTRA_SYMBOLS juggling).
#
# Each techpack keeps its own internal configuration (.conf/.mk files and the
# -include'd config headers). The options below only decide which techpack
# directories are descended into; they intentionally do not reuse the
# techpacks' own Kconfig symbol names (e.g. CONFIG_DRM_MSM), which would
# collide with upstream drivers.

menuconfig QCOM_TECHPACKS
	bool "Qualcomm vendor techpacks (in-tree)"
	depends on ARCH_QCOM && MODULES
	help
	  Build the Qualcomm/Samsung vendor kernel modules (display, camera,
	  audio, video, GPU, WLAN, data, security, ...) from techpack/ as part
	  of the normal kernel build. All techpacks are built as modules.

if QCOM_TECHPACKS

config TECHPACK_PROJECT_NAME
	string "Samsung project name"
	default "e3q"
	help
	  Samsung project (device) name passed to the techpacks as
	  PROJECT_NAME, as the Samsung build did. Selects device specific
	  code, e.g. the camera sensor set. e3q = Galaxy S24 Ultra.

config TECHPACK_BUILD_VARIANT
	string "Android build variant"
	default "user"
	help
	  Value of TARGET_BUILD_VARIANT seen by the techpacks
	  (user, userdebug or eng).

config TECHPACK_MMRM
	bool "MMRM - multimedia resource manager (msm-mmrm.ko)"
	default y

config TECHPACK_MMRM_CLIENTS
	bool "Let video and EVA use the real MMRM API"
	depends on TECHPACK_MMRM
	default n
	help
	  The video and EVA Kbuild files force CONFIG_MSM_MMRM, which makes
	  msm_video.ko and msm-eva.ko register their clocks with msm-mmrm.
	  The stock S24 Ultra modules are built without it (MMRM stubs), so
	  this is off by default to match stock behaviour.

config TECHPACK_SYNX
	bool "Synx - global synchronization framework (synx-driver.ko, ipclite.ko)"
	default y

config TECHPACK_MM_DRIVERS
	bool "MM drivers (msm_ext_display.ko, sync_fence.ko, msm_hw_fence.ko)"
	depends on TECHPACK_SYNX
	default y

config TECHPACK_SECUREMSM
	bool "SecureMSM (qseecom, smcinvoke, tz_log, qce/qcedev/qcrypto, hdcp, qrng, smmu_proxy)"
	default y

config TECHPACK_DISPLAY
	bool "Display - SDE/DSI/DP DRM driver with Samsung panels (msm_drm.ko)"
	depends on TECHPACK_MMRM && TECHPACK_MM_DRIVERS && TECHPACK_SECUREMSM
	default y

config TECHPACK_GRAPHICS
	bool "Graphics - Adreno KGSL (msm_kgsl.ko)"
	depends on TECHPACK_MM_DRIVERS
	default y

config TECHPACK_VIDEO
	bool "Video - Iris V4L2 driver (msm_video.ko, video.ko)"
	depends on TECHPACK_MMRM && TECHPACK_MM_DRIVERS && TECHPACK_SYNX
	default y

config TECHPACK_CAMERA
	bool "Camera - Spectra camera driver with Samsung sensors (camera.ko)"
	depends on TECHPACK_MMRM && TECHPACK_SYNX && TECHPACK_SECUREMSM
	default y

config TECHPACK_AUDIO
	bool "Audio - SPF/ASoC audio drivers (*_dlkm.ko)"
	depends on TECHPACK_MM_DRIVERS
	default y

config TECHPACK_AUDIO_SEC_AMP
	bool "Audio - Samsung amplifier/haptics glue (Cirrus amp, CS40L26)"
	depends on TECHPACK_AUDIO
	default y
	help
	  Enables COMMON_AMP_CIRRUS and USE_CS40L26 in the audio machine
	  driver, as the Samsung Bazel build does for e1q/e2q/e3q. The plain
	  Kbuild path of audio-kernel never set these.

config TECHPACK_DSP
	bool "DSP - FastRPC (frpc-adsprpc.ko, cdsp-loader.ko)"
	default y

config TECHPACK_EVA
	bool "EVA - engine for visual analytics (msm-eva.ko)"
	depends on TECHPACK_MMRM && TECHPACK_SYNX && TECHPACK_DSP
	default y

config TECHPACK_SPU
	bool "SPU - secure processor (spcom.ko, spss_utils.ko)"
	default y

config TECHPACK_BT
	bool "Bluetooth/FM (btpower.ko, bt_fm_slim.ko, radio-i2c-rtc6226-qca.ko)"
	default y

config TECHPACK_DATA
	bool "Data - IPA + RmNet (gsim, ipam, ipanetm, rmnet_core/ctl and rmnet_* extensions)"
	default y
	help
	  dataipa, datarmnet and datarmnet-ext depend on each other
	  (ipam uses rmnet_mem, the rmnet extensions use rmnet_core and
	  rmnet_core uses ipam), so they are enabled together.

config TECHPACK_MM_SYS
	bool "MM sys - UBWC-P (ubwcp.ko)"
	default y

config TECHPACK_WLAN_PLATFORM
	bool "WLAN platform (cnss2.ko, cnss_utils.ko, cnss_nl.ko, cnss_prealloc.ko, ...)"
	default y

config TECHPACK_WLAN
	bool "WLAN host driver qcacld-3.0"
	depends on TECHPACK_WLAN_PLATFORM && TECHPACK_DATA
	default y

config TECHPACK_WLAN_CHIPSET
	string "WLAN chipset"
	depends on TECHPACK_WLAN
	default "kiwi_v2"
	help
	  Chip name; the module is built as qca_cld3_<chipset>.ko.
	  S24 Ultra (FastConnect 7800) uses kiwi_v2.

config TECHPACK_WLAN_PROFILE
	string "WLAN qcacld-3.0 config profile"
	depends on TECHPACK_WLAN
	default "kiwi_v2"
	help
	  Name of techpack/wlan/qcacld-3.0/configs/<profile>_defconfig.
	  kiwi_v2 is the Kbuild profile for this chip (what the non-DDK
	  Android.mk build uses). The <target>_gki_<chip>_defconfig files are
	  written for the Bazel DDK build (its own Kconfig and source lists)
	  and do not map 1:1 onto the Kbuild source selection.

config TECHPACK_TOUCH
	bool "Qualcomm reference touch drivers (not used by Samsung devices)"
	default n

endif # QCOM_TECHPACKS
```
